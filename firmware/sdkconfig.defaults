## firmware/sdkconfig.defaults
```kconfig
# PadProxy ESP32-S3 SDK Configuration Defaults
# These are applied on first build or after `pio run -t menuconfig`.

# ── USB ──────────────────────────────────────────────────────────────────
# Enable TinyUSB on the native USB-OTG peripheral (GPIO 19/20).
CONFIG_TINYUSB=y
CONFIG_TINYUSB_HID_ENABLED=y
CONFIG_TINYUSB_DESC_USE_ESPRESSIF_VID=n
CONFIG_TINYUSB_DESC_USE_DEFAULT_PID=n
CONFIG_TINYUSB_NO_DEFAULT_TASK=y

# ── Bluetooth ────────────────────────────────────────────────────────────
# Bluepad32 uses its own Bluetooth stack (BTstack), so we disable the
# ESP-IDF Bluedroid and NimBLE stacks. Bluepad32 configures the controller
# directly via the HCI transport.
CONFIG_BT_ENABLED=y
CONFIG_BT_BLUEDROID_ENABLED=n
CONFIG_BT_NIMBLE_ENABLED=n
CONFIG_BTDM_CTRL_MODE_BR_EDR_ONLY=n
CONFIG_BTDM_CTRL_MODE_BLE_ONLY=n
CONFIG_BTDM_CTRL_MODE_BTDM=y

# ── System ───────────────────────────────────────────────────────────────
CONFIG_ESP_DEFAULT_CPU_FREQ_MHZ_240=y
CONFIG_FREERTOS_HZ=1000
```
